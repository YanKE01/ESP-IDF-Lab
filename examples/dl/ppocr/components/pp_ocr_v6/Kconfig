## examples/general/https_speed_test/main/Kconfig.projbuild
```kconfig
menu "Simple download speed test"

config SIMPLE_TEST_DOWNLOAD_URL
    string "HTTP/HTTPS download speed test URL"
    default "https://192.168.0.196:8443/download.bin"
    help
        URL used for the download speed test.

config SIMPLE_TEST_DOWNLOAD_BUFFER_IN_PSRAM
    bool "Allocate download buffer in PSRAM"
    depends on SPIRAM
    default y
    help
        Allocate the 32 KB esp_http_client_read buffer in PSRAM instead of
        internal RAM. This is useful for comparing throughput and DRAM usage.

endmenu
```

## examples/general/https_speed_test/sdkconfig.defaults
```kconfig
CONFIG_ESPTOOLPY_NO_STUB=y
CONFIG_ESPTOOLPY_FLASHMODE_QIO=y
CONFIG_ESPTOOLPY_FLASHFREQ_80M=y
CONFIG_ESPTOOLPY_FLASHSIZE_4MB=y

CONFIG_COMPILER_OPTIMIZATION_PERF=y
CONFIG_IDF_EXPERIMENTAL_FEATURES=y

CONFIG_FREERTOS_HZ=1000

CONFIG_EXAMPLE_CONNECT_WIFI=y
CONFIG_EXAMPLE_WIFI_SSID="iottest"
CONFIG_EXAMPLE_WIFI_PASSWORD="12345678"
CONFIG_EXAMPLE_WIFI_SCAN_METHOD_FAST=y
CONFIG_EXAMPLE_WIFI_CONNECT_AP_BY_SIGNAL=y

CONFIG_ESP_TLS_INSECURE=y
CONFIG_ESP_TLS_SKIP_SERVER_CERT_VERIFY=y

CONFIG_ESP_TASK_WDT_TIMEOUT_S=30
```

## examples/general/https_speed_test/sdkconfig.defaults.esp32p4
```kconfig
CONFIG_ESP_DEFAULT_CPU_FREQ_MHZ_400=y

CONFIG_ESP32P4_SELECTS_REV_LESS_V3=n
CONFIG_ESP32P4_REV_MIN_300=y

CONFIG_IDF_EXPERIMENTAL_FEATURES=y
CONFIG_SPIRAM=y
CONFIG_SPIRAM_SPEED_250M=y
CONFIG_SPIRAM_USE_MALLOC=y
CONFIG_SPIRAM_MALLOC_ALWAYSINTERNAL=32768
CONFIG_SPIRAM_ALLOW_BSS_SEG_EXTERNAL_MEMORY=y
CONFIG_SPIRAM_ALLOW_NOINIT_SEG_EXTERNAL_MEMORY=y
CONFIG_SPIRAM_TRY_ALLOCATE_WIFI_LWIP=y

CONFIG_SLAVE_IDF_TARGET_ESP32C6=y
CONFIG_ESP_HOSTED_CP_TARGET_ESP32C6=y
CONFIG_ESP_WIFI_REMOTE_LIBRARY_HOSTED=y

CONFIG_WIFI_RMT_STATIC_RX_BUFFER_NUM=16
CONFIG_WIFI_RMT_DYNAMIC_RX_BUFFER_NUM=64
CONFIG_WIFI_RMT_STATIC_TX_BUFFER_NUM=16
CONFIG_WIFI_RMT_CACHE_TX_BUFFER_NUM=32
CONFIG_WIFI_RMT_AMPDU_TX_ENABLED=y
CONFIG_WIFI_RMT_TX_BA_WIN=32
CONFIG_WIFI_RMT_AMPDU_RX_ENABLED=y
CONFIG_WIFI_RMT_RX_BA_WIN=32
CONFIG_WIFI_RMT_IRAM_OPT=y
CONFIG_WIFI_RMT_RX_IRAM_OPT=y
CONFIG_WIFI_RMT_EXTRA_IRAM_OPT=n
CONFIG_WIFI_RMT_SLP_IRAM_OPT=n

CONFIG_LWIP_TCP_SND_BUF_DEFAULT=65534
CONFIG_LWIP_TCP_WND_DEFAULT=65534
CONFIG_LWIP_TCP_RECVMBOX_SIZE=64
CONFIG_LWIP_UDP_RECVMBOX_SIZE=64
CONFIG_LWIP_TCPIP_RECVMBOX_SIZE=64
CONFIG_LWIP_TCP_SACK_OUT=y

CONFIG_PARTITION_TABLE_OFFSET=0x9000

CONFIG_MBEDTLS_EXTERNAL_MEM_ALLOC=y
CONFIG_MBEDTLS_SSL_IN_CONTENT_LEN=16384

# Toggle these to compare mbedTLS hardware acceleration with software fallback.
# CONFIG_MBEDTLS_HARDWARE_AES=y
# CONFIG_MBEDTLS_HARDWARE_GCM=y
# CONFIG_MBEDTLS_HARDWARE_MPI=y
# CONFIG_MBEDTLS_HARDWARE_SHA=y
# CONFIG_MBEDTLS_HARDWARE_ECC=y
# CONFIG_MBEDTLS_HARDWARE_ECDSA_VERIFY=y

# Software fallback test set. Uncomment these and comment the =y lines above.
CONFIG_MBEDTLS_HARDWARE_AES=n
CONFIG_MBEDTLS_HARDWARE_GCM=n
CONFIG_MBEDTLS_HARDWARE_MPI=n
CONFIG_MBEDTLS_HARDWARE_SHA=n
CONFIG_MBEDTLS_HARDWARE_ECC=n
CONFIG_MBEDTLS_HARDWARE_ECDSA_VERIFY=n

CONFIG_CACHE_L2_CACHE_128KB=y
CONFIG_SIMPLE_TEST_DOWNLOAD_BUFFER_IN_PSRAM=y
```

## examples/peripherals/gpio/early_gpio/bootloader_components/early_gpio/Kconfig
```kconfig
menu "ESP32-S3 early customer signal"
    depends on IDF_TARGET_ESP32S3

    config EXAMPLE_EARLY_SIGNAL_GPIO
        int "Early signal GPIO number"
        range 0 48
        default 16
        help
            GPIO driven to the configured level at the earliest supported
            second-stage bootloader hook. GPIO22 through GPIO25 are not valid
            on ESP32-S3. Also avoid flash, PSRAM, strapping, console, and USB
            pins used by the selected board.

    config EXAMPLE_EARLY_SIGNAL_LEVEL
        int "Active output level"
        range 0 1
        default 1
        help
            Output level driven by the early bootloader hook. Use 1 for an
            active-high customer signal and 0 for active-low.

endmenu
```

## examples/usb/device/cdc_acm/main/Kconfig.projbuild
```kconfig
menu "USB Device Configuration"

    choice TINYUSB_RHPORT
        prompt "TinyUSB Root Port"
        default TINYUSB_RHPORT_HS if IDF_TARGET_ESP32P4 || IDF_TARGET_ESP32S31
        default TINYUSB_RHPORT_FS
        help
            Allows set the USB PHY Controller for TinyUSB: HS (USB OTG2.0 PHY for HighSpeed)

        config TINYUSB_RHPORT_HS
            depends on IDF_TARGET_ESP32P4 || IDF_TARGET_ESP32S31
            bool "High Speed"

        config TINYUSB_RHPORT_FS
            bool "Full Speed"
    endchoice

    choice CDC_ACM_RX_MODE
        prompt "CDC RX handling mode"
        default CDC_ACM_RX_MODE_POLLING
        help
            Select how the application is notified of received CDC data.

        config CDC_ACM_RX_MODE_POLLING
            bool "Polling task"
            help
                Periodically check the CDC RX FIFO from a dedicated FreeRTOS task.

        config CDC_ACM_RX_MODE_CALLBACK
            bool "TinyUSB receive callback"
            help
                Process CDC data when TinyUSB invokes tud_cdc_rx_cb().
    endchoice

endmenu
```

## examples/usb/device/hid_device_audio_ctrl/main/Kconfig.projbuild
```kconfig
menu "USB HID Consumer Control Configuration"

    choice TINYUSB_RHPORT
        prompt "TinyUSB root port"
        default TINYUSB_RHPORT_HS if IDF_TARGET_ESP32P4
        default TINYUSB_RHPORT_FS
        help
            Select the USB controller and PHY used by TinyUSB. ESP32-S3 uses
            the internal Full-Speed PHY. ESP32-P4 supports both Full-Speed
            and High-Speed operation.

        config TINYUSB_RHPORT_HS
            bool "High Speed"
            depends on IDF_TARGET_ESP32P4
            help
                Use the ESP32-P4 USB 2.0 High-Speed controller and UTMI PHY.

        config TINYUSB_RHPORT_FS
            bool "Full Speed"
            help
                Use the internal USB Full-Speed PHY.
    endchoice

    config HID_CONSUMER_BUTTON_GPIO
        int "Volume-down button GPIO"
        default 35 if IDF_TARGET_ESP32P4
        default 0
        range 0 48 if IDF_TARGET_ESP32S3
        range 0 54 if IDF_TARGET_ESP32P4
        help
            GPIO connected to the active-low button. The default is GPIO0 on
            ESP32-S3 and GPIO35 on ESP32-P4.

endmenu
```

## examples/usb/device/hid_device_keyboard/main/Kconfig.projbuild
```kconfig
menu "USB HID Keyboard Configuration"

    choice TINYUSB_RHPORT
        prompt "TinyUSB root port"
        default TINYUSB_RHPORT_HS if IDF_TARGET_ESP32P4
        default TINYUSB_RHPORT_FS
        help
            Select the USB controller and PHY used by TinyUSB. ESP32-S3 uses
            the internal Full-Speed PHY. ESP32-P4 supports both Full-Speed
            and High-Speed operation.

        config TINYUSB_RHPORT_HS
            bool "High Speed"
            depends on IDF_TARGET_ESP32P4
            help
                Use the ESP32-P4 USB 2.0 High-Speed controller and UTMI PHY.

        config TINYUSB_RHPORT_FS
            bool "Full Speed"
            help
                Use the internal USB Full-Speed PHY.
    endchoice

endmenu
```

## examples/usb/device/mtp/main/Kconfig.projbuild
```kconfig
menu "USB MTP Configuration"

    choice TINYUSB_RHPORT
        prompt "TinyUSB root port"
        default TINYUSB_RHPORT_HS if IDF_TARGET_ESP32P4
        default TINYUSB_RHPORT_FS
        help
            Select the USB controller and PHY used by TinyUSB. ESP32-S3 uses
            the internal Full-Speed PHY. ESP32-P4 supports both Full-Speed
            and High-Speed operation.

        config TINYUSB_RHPORT_HS
            bool "High Speed"
            depends on IDF_TARGET_ESP32P4
            help
                Use the ESP32-P4 USB 2.0 High-Speed controller and UTMI PHY.

        config TINYUSB_RHPORT_FS
            bool "Full Speed"
            help
                Use the internal USB Full-Speed PHY.
    endchoice

    config MTP_MAX_FILE_COUNT
        int "Maximum MTP file count"
        default 32
        range 1 120
        help
            Maximum number of SPIFFS files exposed as MTP objects. The upper
            limit keeps the complete object handle array inside one MTP buffer.

    config MTP_SPIFFS_MAX_OPEN_FILES
        int "Maximum open SPIFFS files"
        default 4
        range 2 16
        help
            Maximum number of files that can be opened through the SPIFFS VFS.

    config MTP_SPIFFS_FORMAT_IF_MOUNT_FAILED
        bool "Format SPIFFS if mounting fails"
        default y
        help
            Format the storage partition when it cannot be mounted. Existing
            files in an incompatible or damaged filesystem will be erased.

endmenu
```

## examples/usb/device/usb_host_os_detect/main/Kconfig.projbuild
```kconfig
menu "USB Host OS Detect"

    choice TINYUSB_RHPORT
        prompt "TinyUSB PHY / root port"
        default TINYUSB_RHPORT_HS if IDF_TARGET_ESP32P4
        default TINYUSB_RHPORT_FS
        help
            Select the USB PHY used by TinyUSB. High Speed uses the USB OTG 2.0
            (UTMI) PHY available on ESP32-P4; Full Speed uses the internal FS PHY
            on ESP32-S2/S3.

        config TINYUSB_RHPORT_HS
            bool "High Speed"
        config TINYUSB_RHPORT_FS
            bool "Full Speed"
    endchoice

endmenu
```

## examples/usb/host/msc_host/sdkconfig.defaults.esp32p4
```kconfig
CONFIG_IDF_TARGET="esp32p4"
CONFIG_IDF_TARGET_ESP32P4=y

CONFIG_FATFS_LFN_HEAP=y
CONFIG_FATFS_VFS_FSTAT_BLKSIZE=4096

CONFIG_CHERRYUSB=y
CONFIG_CHERRYUSB_HOST=y
CONFIG_CHERRYUSB_HOST_DWC2_ESP=y
CONFIG_CHERRYUSB_HOST_MSC=y
```

## examples/usb/host/msc_host/sdkconfig.defaults.esp32s3
```kconfig
CONFIG_IDF_TARGET="esp32s3"
CONFIG_IDF_TARGET_ESP32S3=y

CONFIG_ESP_INT_WDT=n
CONFIG_ESP_TASK_WDT=n

CONFIG_ESPTOOLPY_FLASHSIZE_16MB=y
CONFIG_ESPTOOLPY_FLASHSIZE="16MB"

CONFIG_FATFS_LFN_HEAP=y
CONFIG_FATFS_VFS_FSTAT_BLKSIZE=4096

CONFIG_CHERRYUSB=y
CONFIG_CHERRYUSB_HOST=y
CONFIG_CHERRYUSB_HOST_DWC2_ESP=y
CONFIG_CHERRYUSB_HOST_MSC=y
```
